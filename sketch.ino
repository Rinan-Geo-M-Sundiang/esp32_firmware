// main.ino — Guarden ESP32
//
// Irrigation subsystem: dual-zone (lowland/highland), threshold + VPD
// gated, with fault escalation — see irrigation_zones.h /
// irrigation_types.h (finalized v1.0, supersedes the old single-zone
// threshold model that used to live in config_types.h's decideIrrigation()
// — that function is left in place, unused, for reference/rollback only).
//
// Fertilizer subsystem: single pump (one relay, one solenoid), fires
// whenever the shared schedule window is open. No source selection.
#include <DHT.h>
#include "rtdb_client.h"
#include "config_types.h"      // FertSchedule / decideFertPump (fertilizer only)
#include "polled_config.h"
#include "pump.h"               // fertilizer pumps only, as of this revision
#include "firebase_uploader.h"
#include "irrigation_types.h"
#include "water_budget.h"
#include "vpd.h"
#include "irrigation_zones.h"

// ─── Pin definitions ────────────────────────────────────────────────────────
#define DHT_PIN_1   45   // lowland sensor A (tomato/eggplant compartment)
#define DHT_PIN_2   46   // lowland sensor B (averaged with A)
#define DHT_PIN_3   47   // highland sensor (bell pepper compartment)
#define SOIL_PIN_1  1   // lowland sensor A
#define SOIL_PIN_2  2   // lowland sensor B
#define SOIL_PIN_3  10   // highland sensor

// ⚠️ ASSUMPTION — the irrigation doc says pin mapping is "unchanged from
// the original firmware plan," which wasn't included in that doc. Verify
// these three against your actual wiring/pin plan before flashing.
#define RELAY_PIN             48  // shared water pump — fires if either zone is open
#define SOLENOID_PIN_LOWLAND  16
#define SOLENOID_PIN_HIGHLAND 17  // ⚠️ newly assigned, not previously used elsewhere

// Fertilizer pump — single pump, single relay, single solenoid. No source
// selection anymore (previously leachate vs. organic on separate pumps).
#define RELAY_PIN_FERT     18
#define SOLENOID_PIN_FERT  25

// ─── Soil calibration ───────────────────────────────────────────────────────
#define SOIL_DRY 0  // Raw ADC in dry air  -> 0 % moisture
#define SOIL_WET  5460 // Raw ADC in water    -> 100 % moisture

#define DHT_TYPE DHT22
DHT dht1(DHT_PIN_1, DHT_TYPE);
DHT dht2(DHT_PIN_2, DHT_TYPE);
DHT dht3(DHT_PIN_3, DHT_TYPE);

// ─── Timing (ms) ────────────────────────────────────────────────────────────
#define SENSOR_INTERVAL                5000UL
#define UPLOAD_INTERVAL               10000UL
#define CONFIG_POLL_INTERVAL          15000UL
#define REMOTE_OVERRIDE_CHECK_INTERVAL 5000UL

// ─── RTDB client ────────────────────────────────────────────────────────────
RtdbClient rtdb(FIREBASE_DB_URL, FIREBASE_SECRET);

// ─── Fertilizer pump (single pump — one relay, one solenoid) ───────────────
Pump pumpFertilizer("PUMP2(fertilizer)", RELAY_PIN_FERT, SOLENOID_PIN_FERT);

PolledConfig<FertSchedule> fertScheduleCfg(rtdb, "config/fert_schedule_updated",
                                          CONFIG_POLL_INTERVAL, fetchFertSchedule,
                                          FertSchedule{6,0,6,15,{false,true,false,true,false,true,false}});

// ─── Irrigation zone state (dual-zone, finalized logic) ────────────────────
ZoneState lowlandState;
ZoneState highlandState;
ZoneReading lowlandReading  = { 0, 0, 0, false };
ZoneReading highlandReading = { 0, 0, 0, false };

IrrigationCause lowlandCause  = NONE;
IrrigationCause highlandCause = NONE;

EmergencyCapHistory lowlandCapHistory;
EmergencyCapHistory highlandCapHistory;

unsigned long lowlandNormalCooldownUntilMs  = 0;
unsigned long highlandNormalCooldownUntilMs = 0;

WaterBudget lowlandBudget;
WaterBudget highlandBudget;

// ⚠️ ASSUMPTION — RTDB paths for the dual-zone manual override. The doc
// doesn't specify a schema for this revision; adjust to match your actual
// dashboard control paths.
bool remoteOverrideLowland  = false;
bool remoteOverrideHighland = false;

bool lastLoggedLowlandFault  = false;
bool lastLoggedHighlandFault = false;
bool lastLoggedLowland       = false;
bool lastLoggedHighland      = false;
bool lastLoggedPump          = false;

// ─── Runtime sensor state ───────────────────────────────────────────────────
unsigned long lastSensorRead          = 0;
unsigned long lastUpload              = 0;
unsigned long lastRemoteOverrideCheck = 0;

#define NUM_SENSOR_SETS 3
float temps[NUM_SENSOR_SETS]       = {};
float hums[NUM_SENSOR_SETS]        = {};
float moistures[NUM_SENSOR_SETS]   = {};
bool  validSensor[NUM_SENSOR_SETS] = {};

// ─── Helpers ────────────────────────────────────────────────────────────────
float soilToPercent(int raw) {
  float pct = 100.0f * float(SOIL_DRY - raw) / float(SOIL_DRY - SOIL_WET);
  return constrain(pct, 0.0f, 100.0f);
}

void readSensors() {
  DHT* dhts[NUM_SENSOR_SETS]     = { &dht1, &dht2, &dht3 };
  int  soilPins[NUM_SENSOR_SETS] = { SOIL_PIN_1, SOIL_PIN_2, SOIL_PIN_3 };

  for (int i = 0; i < NUM_SENSOR_SETS; i++) {
    float t = dhts[i]->readTemperature();
    float h = dhts[i]->readHumidity();

    if (isnan(t) || isnan(h)) {
      validSensor[i] = false;
      Serial.printf("DHT_ERR sensor-%d\n", i + 1);
      continue;
    }
    temps[i]       = t;
    hums[i]        = h;
    moistures[i]   = soilToPercent(analogRead(soilPins[i]));
    validSensor[i] = true;
    Serial.printf("SENSOR-%d  temp=%.1f  hum=%.1f  moist=%.1f\n", i + 1, t, h, moistures[i]);
  }
}

// ⚠️ ASSUMPTION — sensor 1 + sensor 2 = lowland compartment (averaged,
// matches "2 soil + 2 DHT22 averaged" from the design memory), sensor 3 =
// highland compartment (standalone). Verify against your actual wiring —
// this mapping isn't stated in the irrigation doc itself.
void buildZoneReadings() {
  bool lowlandValid = validSensor[0] && validSensor[1];
  if (lowlandValid) {
    lowlandReading.moisture    = (moistures[0] + moistures[1]) / 2.0f;
    lowlandReading.temperature = (temps[0] + temps[1]) / 2.0f;
    lowlandReading.humidity    = (hums[0] + hums[1]) / 2.0f;
  }
  lowlandReading.valid = lowlandValid;

  highlandReading.valid = validSensor[2];
  if (highlandReading.valid) {
    highlandReading.moisture    = moistures[2];
    highlandReading.temperature = temps[2];
    highlandReading.humidity    = hums[2];
  }
}

// Poll remote overrides asynchronously — decoupled from evaluateZone() cadence.
void checkRemoteOverrideIfNeeded() {
  if (millis() - lastRemoteOverrideCheck < REMOTE_OVERRIDE_CHECK_INTERVAL) return;
  lastRemoteOverrideCheck = millis();

  remoteOverrideLowland  = rtdb.getBool("control/relay_lowland");
  remoteOverrideHighland = rtdb.getBool("control/relay_highland");

  pumpFertilizer.overrideActive = rtdb.getBool("control/relay_fert");
}

// ─── updateIrrigation() — the finalized call site from the design doc ──────
void updateIrrigation() {
  lowlandState.manualOverride  = remoteOverrideLowland;
  highlandState.manualOverride = remoteOverrideHighland;

  float lowlandVpd  = computeVPD(lowlandReading.temperature,  lowlandReading.humidity);
  float highlandVpd = computeVPD(highlandReading.temperature, highlandReading.humidity);

  evaluateZone(lowlandState,  lowlandReading,  lowlandThresh,  lowlandVpd,
               lowlandCause,  lowlandBudget,  WATER_LIMIT_LOWLAND,
               lowlandCapHistory,  lowlandNormalCooldownUntilMs);
  evaluateZone(highlandState, highlandReading, highlandThresh, highlandVpd,
               highlandCause, highlandBudget, WATER_LIMIT_HIGHLAND,
               highlandCapHistory, highlandNormalCooldownUntilMs);

  logIfChanged(lowlandCapHistory.mechanicalLock,  lastLoggedLowlandFault,  "LOWLAND_FAULT");
  logIfChanged(highlandCapHistory.mechanicalLock, lastLoggedHighlandFault, "HIGHLAND_FAULT");

  digitalWrite(SOLENOID_PIN_LOWLAND,  lowlandState.finalActive  ? LOW : HIGH);
  digitalWrite(SOLENOID_PIN_HIGHLAND, highlandState.finalActive ? LOW : HIGH);

  bool pumpShouldRun = lowlandState.finalActive || highlandState.finalActive;
  digitalWrite(RELAY_PIN, pumpShouldRun ? LOW : HIGH);

  logIfChanged(lowlandState.finalActive,  lastLoggedLowland,  "LOWLAND");
  logIfChanged(highlandState.finalActive, lastLoggedHighland, "HIGHLAND");
  logIfChanged(pumpShouldRun,             lastLoggedPump,     "PUMP");
}

// ═════════════════════════════════════════════════════════════════════════
void setup() {
  Serial.begin(115200);
  delay(300);
  Serial.println("\n=== Guarden booting ===");

  pinMode(RELAY_PIN,             OUTPUT);
  pinMode(SOLENOID_PIN_LOWLAND,  OUTPUT);
  pinMode(SOLENOID_PIN_HIGHLAND, OUTPUT);
  digitalWrite(RELAY_PIN,             HIGH); // closed on boot
  digitalWrite(SOLENOID_PIN_LOWLAND,  HIGH);
  digitalWrite(SOLENOID_PIN_HIGHLAND, HIGH);

  pumpFertilizer.begin();

  dht1.begin(); dht2.begin(); dht3.begin();

  Serial.println("Waiting for DHT22 sensors to settle...");
  delay(2500);
  delay(1000);

  Serial.println("Initial sensor read...");
  readSensors();
  buildZoneReadings();

  uploaderBegin();

  Serial.print("WiFi connecting");
  unsigned long t0 = millis();
  while (WiFi.status() != WL_CONNECTED && millis() - t0 < 15000UL) {
    delay(500); Serial.print('.');
  }
  Serial.println();

  if (WiFi.status() == WL_CONNECTED) {
    Serial.println("WiFi connected");

    firebaseInitNTP();
    waitForNTP(10000UL);

    fertScheduleCfg.forceFetch();

    Serial.printf("BOOT FERT SCHEDULE  %02d:%02d-%02d:%02d\n",
                  fertScheduleCfg.value().startHour, fertScheduleCfg.value().startMinute,
                  fertScheduleCfg.value().endHour,   fertScheduleCfg.value().endMinute);
  } else {
    Serial.println("WiFi timeout — using default fert schedule, NTP unavailable");
  }

  lastSensorRead          = millis();
  lastUpload              = millis();
  lastRemoteOverrideCheck = millis();
}

// ═════════════════════════════════════════════════════════════════════════
void loop() {
  // 1. Refresh polled fertilizer schedule (every 15s, only refetches when changed).
  fertScheduleCfg.poll();

  // 2. Read sensors on interval (every 5s).
  if (millis() - lastSensorRead >= SENSOR_INTERVAL) {
    lastSensorRead = millis();
    readSensors();
    buildZoneReadings();
  }

  // 3. Poll manual overrides asynchronously (every 5s).
  checkRemoteOverrideIfNeeded();

  // 4. Drive irrigation (dual-zone, finalized logic) every loop, ~100ms.
  updateIrrigation();

  // 5. Drive the fertilizer pump every loop, ~100ms.
  time_t now; time(&now);
  pumpFertilizer.update(decideFertilizer(fertScheduleCfg.value(), now));

  // 6. Push to Firebase (every 10s).
  if (millis() - lastUpload >= UPLOAD_INTERVAL) {
    lastUpload = millis();

    bool anyValid = validSensor[0] || validSensor[1] || validSensor[2];
    if (!anyValid) {
      Serial.println("UPLOAD_SKIP: no valid sensor readings this cycle");
    } else {
      float avgTemp     = (temps[0] + temps[1] + temps[2]) / 3.0f;
      float avgHum      = (hums[0]  + hums[1]  + hums[2])  / 3.0f;
      float avgMoisture = (moistures[0] + moistures[1] + moistures[2]) / 3.0f;

      Serial.printf("AVG  temp=%.1f  hum=%.1f  moisture=%.1f\n", avgTemp, avgHum, avgMoisture);

      uploadOrBuffer(rtdb, avgTemp, avgHum, avgMoisture, temps, hums, moistures, validSensor);
    }
  }

  delay(100);
}

